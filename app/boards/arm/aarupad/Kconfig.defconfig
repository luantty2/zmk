## app/boards/arm/aarupad/Kconfig.defconfig
```kconfig
# aarupad board configuration

# Copyright (c) 2020 The ZMK Contributors
# SPDX-License-Identifier: MIT

if BOARD_AARUPAD

config ZMK_KEYBOARD_NAME
	default "AARUPAD"

if USB

config USB_NRFX
	default y

config USB_DEVICE_STACK
	default y

endif # USB

config BT_CTLR
	default BT

config ZMK_BLE
	default y

config ZMK_USB
	default y

config ZMK_BATTERY_VOLTAGE_DIVIDER
	default y

endif # BOARD_AARUPAD
```

## app/boards/arm/aarupad/aarupad_defconfig
```kconfig
# SPDX-License-Identifier: MIT

CONFIG_SOC_SERIES_NRF52X=y
CONFIG_SOC_NRF52840_QIAA=y
CONFIG_BOARD_AARUPAD=y

# Enable MPU
CONFIG_ARM_MPU=y

# enable GPIO
CONFIG_GPIO=y

CONFIG_USE_DT_CODE_PARTITION=y

CONFIG_MPU_ALLOW_FLASH_WRITE=y
CONFIG_NVS=y
CONFIG_SETTINGS_NVS=y
CONFIG_FLASH=y
CONFIG_FLASH_PAGE_LAYOUT=y
CONFIG_FLASH_MAP=y

# Enable Underglow
CONFIG_ZMK_RGB_UNDERGLOW=y
CONFIG_WS2812_STRIP=y
CONFIG_ZMK_RGB_UNDERGLOW_HUE_START=170
CONFIG_ZMK_RGB_UNDERGLOW_SAT_START=85
CONFIG_ZMK_RGB_UNDERGLOW_BRT_START=30
CONFIG_ZMK_RGB_UNDERGLOW_EFF_START=1
CONFIG_ZMK_RGB_UNDERGLOW_ON_START=y

CONFIG_ZMK_SLEEP=n
# CONFIG_ZMK_IDLE_SLEEP_TIMEOUT=10000

CONFIG_I2C=y
#CONFIG_MAX17055=y

#CONFIG_ZMK_BATTERY_VOLTAGE_DIVIDER=n


# Enable the rotary encoder
# CONFIG_EC11=y
# CONFIG_EC11_TRIGGER_GLOBAL_THREAD=y
```

## app/boards/arm/flyleg/Kconfig.board
```kconfig
# nice!nano board configuration

# Copyright (c) 2020 Pete Johanson
# SPDX-License-Identifier: MIT

config BOARD_FLYLEG
	bool "flyleg"
	depends on SOC_NRF52840_QIAA
```

## app/boards/arm/flyleg/Kconfig.defconfig
```kconfig
# Electronut Labs Papyr board configuration

# Copyright (c) 2020 Pete Johanson
# SPDX-License-Identifier: MIT

if BOARD_FLYLEG

#config BOARD
#	default "flyleg"

config ZMK_KEYBOARD_NAME
	default "Flyleg"

if USB

config USB_NRFX
	default y

config USB_DEVICE_STACK
	default y

endif # USB

config BT_CTLR
	default BT

config ZMK_BLE
	default y

config ZMK_USB
	default y

endif # BOARD_FLYLEG
```

## app/boards/arm/zmk40/Kconfig.board
```kconfig
# isometria75 rev2 board configuration

# Copyright (c) 2020 The ZMK Contributors
# SPDX-License-Identifier: MIT

config BOARD_ZMK40
	bool "zmk40 Keyboard"
	depends on SOC_NRF52840_QIAA
```
